/*
 * Device Tree Source for the H3ULCB Kingfisher board
 * running XEN hypervisor
 *
 * Copyright (C) 2016-2018 Renesas Electronics Corp.
 * Copyright (C) 2016 Cogent Embedded, Inc.
 *
 * This file is licensed under the terms of the GNU General Public License
 * version 2.  This program is licensed "as is" without any warranty of any
 * kind, whether express or implied.
 */

#include "r8a77951-ulcb-kf.dts"

/*
 * The device tree compiler (DTC) is allocating the phandle from 1 to
 * onwards. Reserve a high value for the GIC phandle.
 */
#define PHANDLE_GIC (65000)

/ {
	soc {
		/* This must point to Xen interrupt-parent */
		interrupt-parent = <PHANDLE_GIC>;
	};

	passthrough {
	};

	/*
	 * When creating DT for the guest domain Xen inserts only dummy CPU nodes.
	 * And the number of these inserted CPU nodes is equal to the number of
	 * vCPUs assigned to this domain. All CPU properties which original DT has,
	 * such as OPP, clock, regulator, etc are not passed to the guest’s DT.
	 *
	 * Example of guest vCPU node:
	 *
	 * cpu@0 {
	 *     device_type = "cpu";
	 *     compatible = "arm,armv8";
	 *     enable-method = "psci";
	 *     reg = <0x0>;
	 * };
	 *
	 * This results in the fact that all features expecting a57_x or a53_x
	 * CPU nodes to be present get broken. This is why we have to explicitly
	 * remove the following.
	 */
	/delete-node/thermal-zones;
	/delete-node/pmu_a57;
	/delete-node/pmu_a53;
	/delete-node/cpus;
	/delete-node/psci;
	/delete-node/aliases;
	/delete-node/timer;

	/delete-node/opp-table0;
	/delete-node/opp-table1;
	/delete-node/opp-table2;
	/delete-node/opp-table3;
	/delete-node/opp-table4;
	/delete-node/opp-table5;
	/delete-node/opp-table6;
	/delete-node/opp-table7;
	/delete-node/opp-table10;

};

/delete-node/&adsp;

/* Xen will provide its own GIC, mask ours */
&gic {
	compatible = "";
};

&scif2 {
	status = "disabled";
};

&sata {
	status = "disabled";
};

/ {
	impdes0		{
		interrupt-parent = <PHANDLE_GIC>;
	};
	imprtt		{
		interrupt-parent = <PHANDLE_GIC>;
	};
};

/* ============================ Devices config section =====================*/

/ {
	avb-mch /* avb-mch*/
	{
		/delete-property/clocks;
		/delete-property/resets;
		/delete-property/power-domains;
	};

	hdmi-out {
		status = "disabled";
	};
};

&soc {
	/* sound passthrough */
	i2c2_clk: i2c2_clk {
		compatible = "fixed-clock";
		/*
		The value "133333328" was taken from /sys/kernel/debug/clk/clk_summary
		for the corresponding clock in DomD.
		*/
		clock-frequency = <133333328>;
		#clock-cells = <0>;
	};

	fixed_clk_66560000: fixed_clk_66560000 {
		compatible = "fixed-clock";
		#clock-cells = <0>;
		clock-frequency = <66560000>;
	};
	fixed_serial_clk: fixed_serial_clk {
		compatible = "fixed-clock";
		#clock-cells = <0>;
		clock-frequency = <266666656>;
	};
	fixed_clk_scif1: fixed_clk_scif1 {
		compatible = "fixed-clock";
		#clock-cells = <0>;
		clock-frequency = <66666664>;
	};


	imp0  /* imp0*/
	{
		/delete-property/clocks;
		/delete-property/resets;
		/delete-property/power-domains;
	};
	imp1  /* imp1*/
	{
		/delete-property/clocks;
		/delete-property/resets;
		/delete-property/power-domains;
	};
	imp2  /* imp2*/
	{
		/delete-property/clocks;
		/delete-property/resets;
		/delete-property/power-domains;
	};
	impc0  /* impc0*/
	{
		/delete-property/clocks;
		/delete-property/resets;
		/delete-property/power-domains;
	};
	impdm0	/* impdm0*/
	{
		/delete-property/clocks;
		/delete-property/resets;
		/delete-property/power-domains;
	};
	imprtt	/* imprtt*/
	{
		/delete-property/clocks;
		/delete-property/resets;
		/delete-property/power-domains;
	};
	impsc0	/* impsc0*/
	{
		/delete-property/clocks;
		/delete-property/resets;
		/delete-property/power-domains;
	};
	impsc1	/* impsc1*/
	{
		/delete-property/clocks;
		/delete-property/resets;
		/delete-property/power-domains;
	};
	impsl0	/* impsl0*/
	{
		/delete-property/clocks;
		/delete-property/resets;
		/delete-property/power-domains;
	};
	imr-lx4@fe860000  /* imr-lx4@fe860000*/
	{
		/delete-property/clocks;
		/delete-property/resets;
		/delete-property/power-domains;
	};
	imr-lx4@fe870000  /* imr-lx4@fe870000*/
	{
		/delete-property/clocks;
		/delete-property/resets;
		/delete-property/power-domains;
	};
	imr-lx4@fe880000  /* imr-lx4@fe880000*/
	{
		/delete-property/clocks;
		/delete-property/resets;
		/delete-property/power-domains;
	};
	imr-lx4@fe890000  /* imr-lx4@fe890000*/
	{
		/delete-property/clocks;
		/delete-property/resets;
		/delete-property/power-domains;
	};

	mfis-as {
		status = "disabled";
	};
};

	&sound_card {
		dais = <&rsnd_port0>;
	};

/delete-node/&sysc;
/delete-node/&cpg;
/delete-node/&rst;

// This is autogenerated dts part
&pcm3168a /* audio-codec@44*/
{
	/delete-property/clocks;
	/delete-property/resets;
	/delete-property/power-domains;
};
&avs /* avs@e60a013c*/
{
	/delete-property/clocks;
	/delete-property/resets;
	/delete-property/power-domains;
	/delete-property/target_devices;
};
&can0 /* can@e6c30000*/
{
	/delete-property/clocks;
	/delete-property/resets;
	/delete-property/power-domains;
};
&can1 /* can@e6c38000*/
{
	/delete-property/clocks;
	/delete-property/resets;
	/delete-property/power-domains;
};
&cmm0 /* cmm@fea40000*/
{
	/delete-property/clocks;
	/delete-property/resets;
	/delete-property/power-domains;
};
&cmm1 /* cmm@fea50000*/
{
	/delete-property/clocks;
	/delete-property/resets;
	/delete-property/power-domains;
};
&cmm2 /* cmm@fea60000*/
{
	/delete-property/clocks;
	/delete-property/resets;
	/delete-property/power-domains;
};
&cmm3 /* cmm@fea70000*/
{
	/delete-property/clocks;
	/delete-property/resets;
	/delete-property/power-domains;
};
&ak4613 /* codec@10*/
{
	/delete-property/resets;
	/delete-property/power-domains;
};
&arm_cc630p /* crypto@e6601000*/
{
	/delete-property/clocks;
	/delete-property/resets;
	/delete-property/power-domains;
};
&csi20 /* csi2@fea80000*/
{
	/delete-property/clocks;
	/delete-property/resets;
	/delete-property/power-domains;
	status = "disabled";
};
&csi40 /* csi2@feaa0000*/
{
	/delete-property/clocks;
	/delete-property/resets;
	/delete-property/power-domains;
	status = "disabled";
};
&du /* display@feb00000*/
{
	/delete-property/clocks;
	/delete-property/resets;
	/delete-property/power-domains;
	status = "disabled";
};
&usb_dmac2 /* dma-controller@e6460000*/
{
	/delete-property/clocks;
	/delete-property/resets;
	/delete-property/power-domains;
};
&usb_dmac3 /* dma-controller@e6470000*/
{
	/delete-property/clocks;
	/delete-property/resets;
	/delete-property/power-domains;
};
&usb_dmac0 /* dma-controller@e65a0000*/
{
	/delete-property/clocks;
	/delete-property/resets;
	/delete-property/power-domains;
};
&usb_dmac1 /* dma-controller@e65b0000*/
{
	/delete-property/clocks;
	/delete-property/resets;
	/delete-property/power-domains;
};
&dmac0 /* dma-controller@e6700000*/
{
	/delete-property/clocks;
	/delete-property/clock-names;
	/delete-property/resets;
	/delete-property/power-domains;
};
&dmac1 /* dma-controller@e7300000*/
{
	/delete-property/clocks;
	/delete-property/resets;
	/delete-property/power-domains;
};
&dmac2 /* dma-controller@e7310000*/
{
	/delete-property/clocks;
	/delete-property/resets;
	/delete-property/power-domains;
};
&audma0 /* dma-controller@ec700000*/
{
	/delete-property/clocks;
	/delete-property/clock-names;
	/delete-property/resets;
	/delete-property/power-domains;
};
&audma1 /* dma-controller@ec720000*/
{
	/delete-property/clocks;
	/delete-property/clock-names;
	/delete-property/resets;
	/delete-property/power-domains;
};
&rt_dmac0 /* dma-controller@ffc10000*/
{
	/delete-property/clocks;
	/delete-property/resets;
	/delete-property/power-domains;
};
&rt_dmac1 /* dma-controller@ffc20000*/
{
	/delete-property/clocks;
	/delete-property/resets;
	/delete-property/power-domains;
};
&avb /* ethernet@e6800000*/
{
	/delete-property/clocks;
	/delete-property/resets;
	/delete-property/power-domains;
};
&fcpvd0 /* fcp@fea27000*/
{
	/delete-property/clocks;
	/delete-property/resets;
	/delete-property/power-domains;
	status = "disabled";
};
&fcpvd1 /* fcp@fea2f000*/
{
	/delete-property/clocks;
	/delete-property/resets;
	/delete-property/power-domains;
	status = "disabled";
};
&fcpvd2 /* fcp@fea37000*/
{
	/delete-property/clocks;
	/delete-property/resets;
	/delete-property/power-domains;
	status = "disabled";
};
&fcpcs /* vcp4@fe90f000*/
{
	/delete-property/clocks;
	/delete-property/resets;
	/delete-property/power-domains;
};
&fdp0 /* fdpm@fe940000*/
{
	/delete-property/clocks;
	/delete-property/resets;
	/delete-property/power-domains;
};
&fdp1 /* fdpm@fe944000*/
{
	/delete-property/clocks;
	/delete-property/resets;
	/delete-property/power-domains;
};
&gpio0 /* gpio@e6050000*/
{
	/delete-property/clocks;
	/delete-property/resets;
	/delete-property/power-domains;
	status = "disabled";
};
&gpio1 /* gpio@e6051000*/
{
	/delete-property/clocks;
	/delete-property/resets;
	/delete-property/power-domains;
	status = "disabled";
};
&gpio2 /* gpio@e6052000*/
{
	/delete-property/clocks;
	/delete-property/resets;
	/delete-property/power-domains;
	status = "disabled";
};
&gpio3 /* gpio@e6053000*/
{
	/delete-property/clocks;
	/delete-property/resets;
	/delete-property/power-domains;
	status = "disabled";
};
&gpio4 /* gpio@e6054000*/
{
	/delete-property/clocks;
	/delete-property/resets;
	/delete-property/power-domains;
	status = "disabled";
};
&gpio5 /* gpio@e6055000*/
{
	/delete-property/clocks;
	/delete-property/resets;
	/delete-property/power-domains;
	status = "disabled";
};
&gpio6 /* gpio@e6055400*/
{
	/delete-property/clocks;
	/delete-property/resets;
	/delete-property/power-domains;
	status = "disabled";
};
&gpio7 /* gpio@e6055800*/
{
	/delete-property/clocks;
	/delete-property/resets;
	/delete-property/power-domains;
	status = "disabled";
};
&gsx /* gsx@fd000000*/
{
	/delete-property/clocks;
	/delete-property/resets;
	/delete-property/power-domains;
	status = "disabled";
};
&hdmi0 /* hdmi@fead0000*/
{
	/delete-property/clocks;
	/delete-property/resets;
	/delete-property/power-domains;
	status = "disabled";
};
&i2c_dvfs /* i2c@e60b0000*/
{
	/delete-property/clocks;
	/delete-property/resets;
	/delete-property/power-domains;
	status = "disabled";
};
&i2c2 /* i2c@e6510000*/
{
	/delete-property/resets;
	/delete-property/power-domains;
	/delete-property/dmas;
	/delete-property/dma-names;
	/delete-property/pinctrl-0;
	/delete-property/pinctrl-names;
	clocks = <&i2c2_clk>;
};
&cs2000
{
	/delete-property/clocks;
	/delete-property/clock-names;
};

&i2c4 /* i2c@e66d8000*/
{
	/delete-property/clocks;
	/delete-property/resets;
	/delete-property/power-domains;
	status = "disabled";
};
&imp_distributer /* impdes0*/
{
	/delete-property/clocks;
	/delete-property/resets;
	/delete-property/power-domains;
};
&lvds0 /* lvds@feb90000*/
{
	/delete-property/clocks;
	/delete-property/resets;
	/delete-property/power-domains;
	status = "disabled";
};
&sdhi0 /* mmc@ee100000*/
{
	/delete-property/clocks;
	/delete-property/resets;
	/delete-property/power-domains;
	status = "disabled";
};
&sdhi2 /* mmc@ee140000*/
{
	/delete-property/clocks;
	/delete-property/resets;
	/delete-property/power-domains;
	status = "disabled";
};
&sdhi3 /* mmc@ee160000*/
{
	/delete-property/clocks;
	/delete-property/resets;
	/delete-property/power-domains;
	status = "disabled";
};
&ipmmu_mm /* mmu@e67b0000*/
{
	/delete-property/clocks;
	/delete-property/resets;
	/delete-property/power-domains;
	status = "disabled";
};
&cmos_camera /* ov5642@3c*/
{
	/delete-property/clocks;
	/delete-property/resets;
	/delete-property/power-domains;
	status = "disabled";
};
&ov5647_camera /* ov5647@36*/
{
	/delete-property/clocks;
	/delete-property/resets;
	/delete-property/power-domains;
	status = "disabled";
};
&pciec1 /* pcie@ee800000*/
{
	/delete-property/clocks;
	/delete-property/resets;
	/delete-property/power-domains;
};
&pciec0 /* pcie@fe000000*/
{
	/delete-property/clocks;
	/delete-property/resets;
	/delete-property/power-domains;
};
&pmic /* pmic@30*/
{
	/delete-property/clocks;
	/delete-property/resets;
	/delete-property/power-domains;
	status = "disabled";
};
&rpc0 /* rpc0@ee200000*/
{
	/delete-property/clocks;
	/delete-property/resets;
	/delete-property/power-domains;
	status = "disabled";
};
&hscif0 /* serial@e6540000*/
{
	clocks = <&fixed_serial_clk>, <&fixed_serial_clk>,
		   <&fixed_serial_clk>;
	/delete-property/resets;
	/delete-property/power-domains;
};
&hscif1 /* serial@e6550000*/
{
	clocks = <&fixed_serial_clk>, <&fixed_serial_clk>,
		   <&fixed_serial_clk>;
	/delete-property/resets;
	/delete-property/power-domains;
};
&scif1 /* serial@e6e68000*/
{
	clocks = <&fixed_clk_scif1>,
		   <&fixed_clk_scif1>,
		   <&fixed_clk_scif1>;
	/delete-property/resets;
	/delete-property/power-domains;
};
&scif2 /* serial@e6e88000*/
{
	/delete-property/clocks;
	/delete-property/resets;
	/delete-property/power-domains;
	status = "disabled";
};
&rcar_sound /* sound@ec500000*/
{
	/delete-property/resets;
	/delete-property/power-domains;
	clocks =
			 /* "ssi-all" */
			 <&fixed_clk_66560000>,
			 /* "ssi.9", "ssi.8" */
			 <&fixed_clk_66560000>, <&fixed_clk_66560000>,
			 /* "ssi.7", "ssi.6" */
			 <&fixed_clk_66560000>, <&fixed_clk_66560000>,
			 /* "ssi.5", "ssi.4" */
			 <&fixed_clk_66560000>, <&fixed_clk_66560000>,
			 /* "ssi.3", "ssi.2" */
			 <&fixed_clk_66560000>, <&fixed_clk_66560000>,
			 /* "ssi.1", "ssi.0" */
			 <&fixed_clk_66560000>, <&fixed_clk_66560000>,
			 /* "src.9", "src.8" */
			 <&fixed_clk_66560000>, <&fixed_clk_66560000>,
			 /* "src.7", "src.6" */
			 <&fixed_clk_66560000>, <&fixed_clk_66560000>,
			 /* "src.5", "src.4" */
			 <&fixed_clk_66560000>, <&fixed_clk_66560000>,
			 /* "src.3", "src.2" */
			 <&fixed_clk_66560000>, <&fixed_clk_66560000>,
			 /* "src.1", "src.0" */
			 <&fixed_clk_66560000>, <&fixed_clk_66560000>,
			 /* "mix.1", "mix.0" */
			 <&fixed_clk_66560000>, <&fixed_clk_66560000>,
			 /* "ctu.1", "ctu.0" */
			 <&fixed_clk_66560000>, <&fixed_clk_66560000>,
			 /* "dvc.0", "dvc.1" */
			 <&fixed_clk_66560000>, <&fixed_clk_66560000>,
			 /* "clk_a", "clk_b" */
			 <&audio_clk_a>, <&cs2000>,
			 /* "clk_c", "clk_i" */
			 <&audio_clk_c>, <&i2c2_clk>;
		clock-names = "ssi-all",
				  "ssi.9", "ssi.8", "ssi.7", "ssi.6",
				  "ssi.5", "ssi.4", "ssi.3", "ssi.2",
				  "ssi.1", "ssi.0",
				  "src.9", "src.8", "src.7", "src.6",
				  "src.5", "src.4", "src.3", "src.2",
				  "src.1", "src.0",
				  "mix.1", "mix.0",
				  "ctu.1", "ctu.0",
				  "dvc.0", "dvc.1",
				  "clk_a", "clk_b", "clk_c", "clk_i";

};
&tsc /* thermal@e6198000*/
{
	/delete-property/clocks;
	/delete-property/resets;
	/delete-property/power-domains;
	status = "disabled";
};
&usb2_phy0 /* usb-phy@ee080200*/
{
	/delete-property/clocks;
	/delete-property/resets;
	/delete-property/power-domains;
};
&usb2_phy1 /* usb-phy@ee0a0200*/
{
	/delete-property/clocks;
	/delete-property/resets;
	/delete-property/power-domains;
};
&hsusb /* usb@e6590000*/
{
	/delete-property/clocks;
	/delete-property/resets;
	/delete-property/power-domains;
};
&xhci0 /* usb@ee000000*/
{
	/delete-property/clocks;
	/delete-property/resets;
	/delete-property/power-domains;
};
&ohci0 /* usb@ee080000*/
{
	/delete-property/clocks;
	/delete-property/resets;
	/delete-property/power-domains;
};
&ehci0 /* usb@ee080100*/
{
	/delete-property/clocks;
	/delete-property/resets;
	/delete-property/power-domains;
};
&ohci1 /* usb@ee0a0000*/
{
	/delete-property/clocks;
	/delete-property/resets;
	/delete-property/power-domains;
};
&ehci1 /* usb@ee0a0100*/
{
	/delete-property/clocks;
	/delete-property/resets;
	/delete-property/power-domains;
};
&ivdp1c /* vcp4@fe8d0000*/
{
	/delete-property/clocks;
	/delete-property/resets;
	/delete-property/power-domains;
};
&vdpb /* vcp4@fe900000*/
{
	/delete-property/clocks;
	/delete-property/resets;
	/delete-property/power-domains;
};
&fcpcs	/* vcp4@fe90f000*/
{
	/delete-property/clocks;
	/delete-property/resets;
	/delete-property/power-domains;
};
&vcplf /* vcp4@fe910000*/
{
	/delete-property/clocks;
	/delete-property/resets;
	/delete-property/power-domains;
};
&vin0 /* video@e6ef0000*/
{
	/delete-property/clocks;
	/delete-property/resets;
	/delete-property/power-domains;
	status = "disabled";
};
&vin1 /* video@e6ef1000*/
{
	/delete-property/clocks;
	/delete-property/resets;
	/delete-property/power-domains;
	status = "disabled";
};
&vin2 /* video@e6ef2000*/
{
	/delete-property/clocks;
	/delete-property/resets;
	/delete-property/power-domains;
	status = "disabled";
};
&vin3 /* video@e6ef3000*/
{
	/delete-property/clocks;
	/delete-property/resets;
	/delete-property/power-domains;
	status = "disabled";
};
&vin4 /* video@e6ef4000*/
{
	/delete-property/clocks;
	/delete-property/resets;
	/delete-property/power-domains;
	status = "disabled";
};
&vin5 /* video@e6ef5000*/
{
	/delete-property/clocks;
	/delete-property/resets;
	/delete-property/power-domains;
	status = "disabled";
};
&vspd0 /* vsp@fea20000*/
{
	/delete-property/clocks;
	/delete-property/resets;
	/delete-property/power-domains;
	status = "disabled";
};
&vspd1 /* vsp@fea28000*/
{
	/delete-property/clocks;
	/delete-property/resets;
	/delete-property/power-domains;
	status = "disabled";
};
&vspd2 /* vsp@fea30000*/
{
	/delete-property/clocks;
	/delete-property/resets;
	/delete-property/power-domains;
	status = "disabled";
};
&vspbc /* vspm@fe920000*/
{
	/delete-property/clocks;
	/delete-property/resets;
	/delete-property/power-domains;
	status = "disabled";
};
&vspbd /* vspm@fe960000*/
{
	/delete-property/clocks;
	/delete-property/resets;
	/delete-property/power-domains;
	status = "disabled";
};
&vspi0 /* vspm@fe9a0000*/
{
	/delete-property/clocks;
	/delete-property/resets;
	/delete-property/power-domains;
	status = "disabled";
};
&vspi1 /* vspm@fe9b0000*/
{
	/delete-property/clocks;
	/delete-property/resets;
	/delete-property/power-domains;
	status = "disabled";
};
&rwdt /* watchdog@e6020000*/
{
	/delete-property/clocks;
	/delete-property/resets;
	/delete-property/power-domains;
	status = "disabled";
};

&src0
{
	/delete-property/clocks;
	/delete-property/resets;
	/delete-property/power-domains;
};
&src1
{
	/delete-property/clocks;
	/delete-property/resets;
	/delete-property/power-domains;
};
&src2
{
	/delete-property/clocks;
	/delete-property/resets;
	/delete-property/power-domains;
};
&src3
{
	/delete-property/clocks;
	/delete-property/resets;
	/delete-property/power-domains;
};
&src4
{
	/delete-property/clocks;
	/delete-property/resets;
	/delete-property/power-domains;
};
&src5
{
	/delete-property/clocks;
	/delete-property/resets;
	/delete-property/power-domains;
};
&src6
{
	/delete-property/clocks;
	/delete-property/resets;
	/delete-property/power-domains;
};
&src7
{
	/delete-property/clocks;
	/delete-property/resets;
	/delete-property/power-domains;
};
&src8
{
	/delete-property/clocks;
	/delete-property/resets;
	/delete-property/power-domains;
};
&src9
{
	/delete-property/clocks;
	/delete-property/resets;
	/delete-property/power-domains;
};
&ssi0
{
	/delete-property/clocks;
	/delete-property/resets;
	/delete-property/power-domains;
};
&ssi1
{
	/delete-property/clocks;
	/delete-property/resets;
	/delete-property/power-domains;
};
&ssi2
{
	/delete-property/clocks;
	/delete-property/resets;
	/delete-property/power-domains;
};
&ssi3
{
	/delete-property/clocks;
	/delete-property/resets;
	/delete-property/power-domains;
};
&ssi4
{
	/delete-property/clocks;
	/delete-property/resets;
	/delete-property/power-domains;
};
&ssi5
{
	/delete-property/clocks;
	/delete-property/resets;
	/delete-property/power-domains;
};
&ssi6
{
	/delete-property/clocks;
	/delete-property/resets;
	/delete-property/power-domains;
};
&ssi7
{
	/delete-property/clocks;
	/delete-property/resets;
	/delete-property/power-domains;
};
&ssi8
{
	/delete-property/clocks;
	/delete-property/resets;
	/delete-property/power-domains;
};
&ssi9
{
	/delete-property/clocks;
	/delete-property/resets;
	/delete-property/power-domains;
};

// End of autogenerated dts part


// disabled nodes
&cmt0 /* timer@e60f0000*/
{
	/delete-property/clocks;
	/delete-property/resets;
	/delete-property/interrupts;
	/delete-property/power-domains;
};
&cmt1 /* timer@e6130000*/
{
	/delete-property/clocks;
	/delete-property/resets;
	/delete-property/interrupts;
	/delete-property/power-domains;
};
&cmt2 /* timer@e6140000*/
{
	/delete-property/clocks;
	/delete-property/resets;
	/delete-property/interrupts;
	/delete-property/power-domains;
};
&cmt3 /* timer@e6148000*/
{
	/delete-property/clocks;
	/delete-property/resets;
	/delete-property/interrupts;
	/delete-property/power-domains;
};
&intc_ex /* interrupt-controller@e61c0000*/
{
	/delete-property/clocks;
	/delete-property/resets;
	/delete-property/interrupts;
	/delete-property/power-domains;
	status = "disabled";
};
&i2c0 /* i2c@e6500000*/
{
	/delete-property/clocks;
	/delete-property/resets;
	/delete-property/interrupts;
	/delete-property/power-domains;
};
&i2c1 /* i2c@e6508000*/
{
	/delete-property/clocks;
	/delete-property/resets;
	/delete-property/interrupts;
	/delete-property/power-domains;
};
&i2c3 /* i2c@e66d0000*/
{
	/delete-property/clocks;
	/delete-property/resets;
	/delete-property/interrupts;
	/delete-property/power-domains;
};
&i2c5 /* i2c@e66e0000*/
{
	/delete-property/clocks;
	/delete-property/resets;
	/delete-property/interrupts;
	/delete-property/power-domains;
};
&i2c6 /* i2c@e66e8000*/
{
	/delete-property/clocks;
	/delete-property/resets;
	/delete-property/interrupts;
	/delete-property/power-domains;
};
&hscif2 /* serial@e6560000*/
{
	/delete-property/clocks;
	/delete-property/resets;
	/delete-property/interrupts;
	/delete-property/power-domains;
};
&hscif3 /* serial@e66a0000*/
{
	/delete-property/clocks;
	/delete-property/resets;
	/delete-property/interrupts;
	/delete-property/power-domains;
};
&hscif4 /* serial@e66b0000*/
{
	/delete-property/clocks;
	/delete-property/resets;
	/delete-property/interrupts;
	/delete-property/power-domains;
};
&hsusb3 /* usb@e659c000*/
{
	/delete-property/clocks;
	/delete-property/resets;
	/delete-property/interrupts;
	/delete-property/power-domains;
};
&usb3_phy0 /* usb-phy@e65ee000*/
{
	/delete-property/clocks;
	/delete-property/resets;
	/delete-property/interrupts;
	/delete-property/power-domains;
};
&ipmmu_ds0 /* iommu@e6740000*/
{
	/delete-property/clocks;
	/delete-property/resets;
	/delete-property/interrupts;
	/delete-property/power-domains;
};
&ipmmu_ds1 /* iommu@e7740000*/
{
	/delete-property/clocks;
	/delete-property/resets;
	/delete-property/interrupts;
	/delete-property/power-domains;
};
&ipmmu_hc /* iommu@e6570000*/
{
	/delete-property/clocks;
	/delete-property/resets;
	/delete-property/interrupts;
	/delete-property/power-domains;
};
&ipmmu_ir /* iommu@ff8b0000*/
{
	/delete-property/clocks;
	/delete-property/resets;
	/delete-property/interrupts;
	/delete-property/power-domains;
};
&ipmmu_mp0 /* iommu@ec670000*/
{
	/delete-property/clocks;
	/delete-property/resets;
	/delete-property/interrupts;
	/delete-property/power-domains;
};
&ipmmu_pv0 /* iommu@fd800000*/
{
	/delete-property/clocks;
	/delete-property/resets;
	/delete-property/interrupts;
	/delete-property/power-domains;
};
&ipmmu_pv1 /* iommu@fd950000*/
{
	/delete-property/clocks;
	/delete-property/resets;
	/delete-property/interrupts;
	/delete-property/power-domains;
};
&ipmmu_pv2 /* iommu@fd960000*/
{
	/delete-property/clocks;
	/delete-property/resets;
	/delete-property/interrupts;
	/delete-property/power-domains;
};
&ipmmu_pv3 /* iommu@fd970000*/
{
	/delete-property/clocks;
	/delete-property/resets;
	/delete-property/interrupts;
	/delete-property/power-domains;
};
&ipmmu_rt /* iommu@ffc80000*/
{
	/delete-property/clocks;
	/delete-property/resets;
	/delete-property/interrupts;
	/delete-property/power-domains;
};
&ipmmu_vc0 /* iommu@fe6b0000*/
{
	/delete-property/clocks;
	/delete-property/resets;
	/delete-property/interrupts;
	/delete-property/power-domains;
};
&ipmmu_vc1 /* iommu@fe6f0000*/
{
	/delete-property/clocks;
	/delete-property/resets;
	/delete-property/interrupts;
	/delete-property/power-domains;
};
&ipmmu_vi0 /* iommu@febd0000*/
{
	/delete-property/clocks;
	/delete-property/resets;
	/delete-property/interrupts;
	/delete-property/power-domains;
};
&ipmmu_vi1 /* iommu@febe0000*/
{
	/delete-property/clocks;
	/delete-property/resets;
	/delete-property/interrupts;
	/delete-property/power-domains;
};
&ipmmu_vp0 /* iommu@fe990000*/
{
	/delete-property/clocks;
	/delete-property/resets;
	/delete-property/interrupts;
	/delete-property/power-domains;
};
&ipmmu_vp1 /* iommu@fe980000*/
{
	/delete-property/clocks;
	/delete-property/resets;
	/delete-property/interrupts;
	/delete-property/power-domains;
};
&canfd /* can@e66c0000*/
{
	/delete-property/clocks;
	/delete-property/resets;
	/delete-property/interrupts;
	/delete-property/power-domains;
};
&pwm0 /* pwm@e6e30000*/
{
	/delete-property/clocks;
	/delete-property/resets;
	/delete-property/interrupts;
	/delete-property/power-domains;
};
&pwm1 /* pwm@e6e31000*/
{
	/delete-property/clocks;
	/delete-property/resets;
	/delete-property/interrupts;
	/delete-property/power-domains;
};
&pwm2 /* pwm@e6e32000*/
{
	/delete-property/clocks;
	/delete-property/resets;
	/delete-property/interrupts;
	/delete-property/power-domains;
};
&pwm3 /* pwm@e6e33000*/
{
	/delete-property/clocks;
	/delete-property/resets;
	/delete-property/interrupts;
	/delete-property/power-domains;
};
&pwm4 /* pwm@e6e34000*/
{
	/delete-property/clocks;
	/delete-property/resets;
	/delete-property/interrupts;
	/delete-property/power-domains;
};
&pwm5 /* pwm@e6e35000*/
{
	/delete-property/clocks;
	/delete-property/resets;
	/delete-property/interrupts;
	/delete-property/power-domains;
};
&pwm6 /* pwm@e6e36000*/
{
	/delete-property/clocks;
	/delete-property/resets;
	/delete-property/interrupts;
	/delete-property/power-domains;
};
&scif0 /* serial@e6e60000*/
{
	/delete-property/clocks;
	/delete-property/resets;
	/delete-property/interrupts;
	/delete-property/power-domains;
};
&scif3 /* serial@e6c50000*/
{
	/delete-property/clocks;
	/delete-property/resets;
	/delete-property/interrupts;
	/delete-property/power-domains;
};
&scif4 /* serial@e6c40000*/
{
	/delete-property/clocks;
	/delete-property/resets;
	/delete-property/interrupts;
	/delete-property/power-domains;
};
&scif5 /* serial@e6f30000*/
{
	/delete-property/clocks;
	/delete-property/resets;
	/delete-property/interrupts;
	/delete-property/power-domains;
};
&tpu /* pwm@e6e80000*/
{
	/delete-property/clocks;
	/delete-property/resets;
	/delete-property/interrupts;
	/delete-property/power-domains;
};
&mlp /* mlp@ec520000*/
{
	/delete-property/clocks;
	/delete-property/resets;
	/delete-property/interrupts;
	/delete-property/power-domains;
};
&msiof0 /* spi@e6e90000*/
{
	/delete-property/clocks;
	/delete-property/resets;
	/delete-property/interrupts;
	/delete-property/power-domains;
};
&msiof1 /* spi@e6ea0000*/
{
	/delete-property/clocks;
	/delete-property/resets;
	/delete-property/interrupts;
	/delete-property/power-domains;
};
&msiof2 /* spi@e6c00000*/
{
	/delete-property/clocks;
	/delete-property/resets;
	/delete-property/interrupts;
	/delete-property/power-domains;
};
&msiof3 /* spi@e6c10000*/
{
	/delete-property/clocks;
	/delete-property/resets;
	/delete-property/interrupts;
	/delete-property/power-domains;
};
&vin6 /* video@e6ef6000*/
{
	/delete-property/clocks;
	/delete-property/resets;
	/delete-property/interrupts;
	/delete-property/power-domains;
};
&vin7 /* video@e6ef7000*/
{
	/delete-property/clocks;
	/delete-property/resets;
	/delete-property/interrupts;
	/delete-property/power-domains;
};
&drif00 /* rif@e6f40000*/
{
	/delete-property/clocks;
	/delete-property/resets;
	/delete-property/interrupts;
	/delete-property/power-domains;
};
&drif01 /* rif@e6f50000*/
{
	/delete-property/clocks;
	/delete-property/resets;
	/delete-property/interrupts;
	/delete-property/power-domains;
};
&drif10 /* rif@e6f60000*/
{
	/delete-property/clocks;
	/delete-property/resets;
	/delete-property/interrupts;
	/delete-property/power-domains;
};
&drif11 /* rif@e6f70000*/
{
	/delete-property/clocks;
	/delete-property/resets;
	/delete-property/interrupts;
	/delete-property/power-domains;
};
&drif20 /* rif@e6f80000*/
{
	/delete-property/clocks;
	/delete-property/resets;
	/delete-property/interrupts;
	/delete-property/power-domains;
};
&drif21 /* rif@e6f90000*/
{
	/delete-property/clocks;
	/delete-property/resets;
	/delete-property/interrupts;
	/delete-property/power-domains;
};
&drif30 /* rif@e6fa0000*/
{
	/delete-property/clocks;
	/delete-property/resets;
	/delete-property/interrupts;
	/delete-property/power-domains;
};
&drif31 /* rif@e6fb0000*/
{
	/delete-property/clocks;
	/delete-property/resets;
	/delete-property/interrupts;
	/delete-property/power-domains;
};
&usb3_peri0 /* usb@ee020000*/
{
	/delete-property/clocks;
	/delete-property/resets;
	/delete-property/interrupts;
	/delete-property/power-domains;
};
&ohci2 /* usb@ee0c0000*/
{
	/delete-property/clocks;
	/delete-property/resets;
	/delete-property/interrupts;
	/delete-property/power-domains;
};
&ohci3 /* usb@ee0e0000*/
{
	/delete-property/clocks;
	/delete-property/resets;
	/delete-property/interrupts;
	/delete-property/power-domains;
};
&ehci2 /* usb@ee0c0100*/
{
	/delete-property/clocks;
	/delete-property/resets;
	/delete-property/interrupts;
	/delete-property/power-domains;
};
&ehci3 /* usb@ee0e0100*/
{
	/delete-property/clocks;
	/delete-property/resets;
	/delete-property/interrupts;
	/delete-property/power-domains;
};
&usb2_phy2 /* usb-phy@ee0c0200*/
{
	/delete-property/clocks;
	/delete-property/resets;
	/delete-property/interrupts;
	/delete-property/power-domains;
};
&usb2_phy3 /* usb-phy@ee0e0200*/
{
	/delete-property/clocks;
	/delete-property/resets;
	/delete-property/interrupts;
	/delete-property/power-domains;
};
&sdhi1 /* mmc@ee120000*/
{
	/delete-property/clocks;
	/delete-property/resets;
	/delete-property/interrupts;
	/delete-property/power-domains;
};
&sata /* sata@ee300000*/
{
	/delete-property/clocks;
	/delete-property/resets;
	/delete-property/interrupts;
	/delete-property/power-domains;
};
&gic /* interrupt-controller@f1010000*/
{
	/delete-property/clocks;
	/delete-property/resets;
	/delete-property/interrupts;
	/delete-property/power-domains;
};
&csi41 /* csi2@feab0000*/
{
	/delete-property/clocks;
	/delete-property/resets;
	/delete-property/interrupts;
	/delete-property/power-domains;
};
&hdmi1 /* hdmi@feae0000*/
{
	/delete-property/clocks;
	/delete-property/resets;
	/delete-property/interrupts;
	/delete-property/power-domains;
};

&soc {
	imp3  /* imp3*/
	{
		/delete-property/clocks;
		/delete-property/resets;
		/delete-property/interrupts;
		/delete-property/power-domains;
	};
};

&can0 /* /soc/can@e6c30000 */
{
	/delete-property/clocks;
	/delete-property/assigned-clocks;
	/delete-property/resets;
	/delete-property/interrupts;
	/delete-property/power-domains;
};

&can1 /*  /soc/can@e6c38000 */
{
	/delete-property/clocks;
	/delete-property/assigned-clocks;
	/delete-property/resets;
	/delete-property/interrupts;
	/delete-property/power-domains;
};
&canfd/*  /soc/can@e66c0000 */
{
	/delete-property/clocks;
	/delete-property/assigned-clocks;
	/delete-property/resets;
	/delete-property/interrupts;
	/delete-property/power-domains;
};

// end of disabled nodes
